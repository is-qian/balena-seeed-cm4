## layers/meta-balena-seeed-cm4/conf/machine/seeed-recomputer-r100x.conf
```bitbake
#@TYPE: Machine
#@NAME: RaspberrypiCM4-IOBoard
#@DESCRIPTION: Machine configuration for Raspberrypi Compute Module 4 IO Board

MACHINEOVERRIDES = "raspberrypi4-64:${MACHINE}"
include conf/machine/raspberrypi4-64.conf

# because we override the raspberrypi4-64 machine which in turn is an override of raspberrypi4, we need to do the following gimmick:
# courtesy of https://github.com/balena-os/balena-jetson/pull/112/commits/9d21df6899e595b4aeab4cc9a939ae6c564c669a
MACHINEOVERRIDES := "${@'${MACHINEOVERRIDES}'.replace(':${MACHINE}',':raspberrypi4-64:${MACHINE}')}"

PREFERRED_VERSION_linux-raspberrypi ?= "6.1.%"

RPI_KERNEL_DEVICETREE_OVERLAYS:append = " overlays/reComputer-R100x.dtbo overlays/i2c0.dtbo \ 
overlays/i2c1.dtbo overlays/i2c3.dtbo overlays/i2c6.dtbo"
KERNEL_MODULE_AUTOLOAD:rpi += "i2c-dev"
ENABLE_I2C = "1"
ENABLE_UART = "1"
```
